## Kconfig
```kconfig
# Cornix v3.0.0はZMK用の保存領域・ブートローダーを定義するが、対応フラグが未設定。
# 修飾付きのCornixターゲットでNVSを使用する場合に限って補う。
config ZMK_BOARD_COMPAT
    default y if (BOARD_CORNIX_PH_LEFT_NRF52840_ZMK || BOARD_CORNIX_RIGHT_NRF52840_ZMK) && SETTINGS_NVS
```

## config/west.yml
```yaml
manifest:
  remotes:
    - name: zmkfirmware
      url-base: https://github.com/zmkfirmware
    - name: hitsmaxft
      url-base: https://github.com/hitsmaxft
    - name: prospector
      url-base: https://github.com/t-ogura
  projects:
    # Zephyr 4.1対応版を固定し、再ビルド時の意図しない変更を防ぐ。
    - name: zmk
      remote: zmkfirmware
      revision: 5b51501fead672c41b5cfb396f3dafe0894bf4e9
      import: app/west.yml
    # Cornix v3.0.0。
    - name: zmk-keyboard-cornix
      remote: hitsmaxft
      revision: ee80f2475b4310e761f5f271371e41172db8b5ca
    # Prospector Scanner・状態送信モジュール v2.2.3。
    - name: prospector-zmk-module
      remote: prospector
      revision: 72a71aeea816eb0f86ffc5b108b267076ce5f0af
      path: modules/prospector-zmk-module
  self:
    path: config
```
